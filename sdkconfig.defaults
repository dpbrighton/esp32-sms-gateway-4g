## sdkconfig.defaults
```kconfig
CONFIG_ESP_WIFI_SSID="BE-49"
CONFIG_ESP_WIFI_PASSWORD="32Crosslet"
CONFIG_ESP_MAXIMUM_RETRY=5
CONFIG_A7670E_UART_PORT=1
CONFIG_A7670E_UART_BAUD=115200
CONFIG_A7670E_TX_PIN=17
CONFIG_A7670E_RX_PIN=16
CONFIG_A7670E_PWRKEY_PIN=4
CONFIG_A7670E_RESET_PIN=5
CONFIG_MQTT_BROKER_URI="mqtt://broker.hivemq.com:1883"
CONFIG_MQTT_TOPIC_PREFIX="smsgateway"
CONFIG_WEBHOOK_URL="http://your-server.example.com/sms-webhook"
CONFIG_WEBHOOK_ENABLED=y
CONFIG_SMS_MAX_INBOX=50
CONFIG_SMS_MAX_OUTBOX=50
CONFIG_LOG_DEFAULT_LEVEL_INFO=y
CONFIG_FREERTOS_HZ=1000
CONFIG_HTTPD_WS_SUPPORT=y
CONFIG_PARTITION_TABLE_CUSTOM=y
CONFIG_PARTITION_TABLE_CUSTOM_FILENAME="partitions.csv"
CONFIG_PARTITION_TABLE_OFFSET=0x8000
CONFIG_ESPTOOLPY_FLASHSIZE_4MB=y
CONFIG_ESPTOOLPY_FLASHSIZE="4MB"
```
